## config/boards/arm/egokb_control/Kconfig.defconfig
```kconfig
# BlueMicro840 board configuration

# Copyright (c) 2020 Pete Johanson, Derek Schmell
# SPDX-License-Identifier: MIT

if BOARD_EGOKB_CONTROL
    config BOARD
    default "egokb_control"
    config BT_SMP_SC_PAIR_ONLY
        default n

    if USB_DEVICE_STACK

        config USB_NRFX
            default y

    endif # USB_DEVICE_STACK

    config BT_CTLR
        default BT
endif
```

## config/boards/shields/flkb/Kconfig.defconfig
```kconfig
if SHIELD_FLKB_LEFT

config ZMK_KEYBOARD_NAME
	default "FLKB"

config ZMK_SPLIT_ROLE_CENTRAL
	default y 

endif 

if SHIELD_FLKB_RIGHT
config ZMK_KEYBOARD_NAME
    default "FLKB_R"
endif

if SHIELD_FLKB_LEFT || SHIELD_FLKB_RIGHT

config ZMK_SPLIT
	default y

config SPI
    bool
    default y

config BT_CTLR
    default BT

config ZMK_BLE
    default y

config ZMK_USB
    default y

config ZMK_BATTERY_VOLTAGE_DIVIDER
    default y

if USB

config USB_NRFX
    default y

config USB_DEVICE_STACK
    default y

endif # USB

config ZMK_IDLE_TIMEOUT
    default 30000
config ZMK_SLEEP
    default n
config ZMK_IDLE_SLEEP_TIMEOUT
    default 900000
endif
```
