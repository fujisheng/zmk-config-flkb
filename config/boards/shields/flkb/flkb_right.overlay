/*
 * Copyright (c) 2020 The ZMK Contributors
 *
 * SPDX-License-Identifier: MIT
 */

#include "flkb.dtsi"

&default_transform {
	col-offset = <6>;
};

&kscan0 {
	col-gpios
		= <&gpio0 10 (GPIO_ACTIVE_HIGH | GPIO_PULL_DOWN)>
		, <&gpio0 9 (GPIO_ACTIVE_HIGH | GPIO_PULL_DOWN)>
		, <&gpio0 24 (GPIO_ACTIVE_HIGH | GPIO_PULL_DOWN)>
		, <&gpio1 11  (GPIO_ACTIVE_HIGH | GPIO_PULL_DOWN)>
		, <&gpio0 31  (GPIO_ACTIVE_HIGH | GPIO_PULL_DOWN)>
		, <&gpio0 29  (GPIO_ACTIVE_HIGH | GPIO_PULL_DOWN)>
		;
};
